## CMakeLists.txt
```
# SPDX-License-Identifier: Apache-2.0

cmake_minimum_required(VERSION 3.20)

find_package(Zephyr REQUIRED HINTS $ENV{ZEPHYR_BASE})
project(clip)

# Include directories
target_include_directories(app PRIVATE include)

# Source files
target_sources(app PRIVATE
    src/main.c
    src/clip_event.c
    src/config.c
    src/ble.c
    src/transport.c
    src/transport_ble.c
    src/at_server.c
    src/at_commands.c
    src/audio.c
    src/storage.c
    src/transfer.c
    src/haptic.c
    src/button.c
    src/display.c
    src/icons.c
    src/wifi_udp.c
    src/transport_udp.c
    src/battery.c
    src/usb_cdc.c
)

if(CONFIG_CLIP_HTTPS_POC)
    # NCS nrf-config.h does not expose Zephyr's HAVE_TIME_DATE Kconfig option.
    # Apply to the entire application image including its TLS/X.509 libraries.
    zephyr_compile_definitions(MBEDTLS_HAVE_TIME MBEDTLS_HAVE_TIME_DATE MBEDTLS_PLATFORM_MS_TIME_ALT)
    # Hostap selects MBEDTLS_ENABLE_HEAP unconditionally in this NCS version.
    # Replace only this image's initializer, at the SDK's original init priority;
    # leave the shared SDK and its public calloc/free API unchanged.
    get_target_property(_tls_sources mbedtls_zephyr SOURCES)
    set(_tls_initializers ${_tls_sources})
    list(FILTER _tls_initializers INCLUDE REGEX "(^|/)mbedtls_heap[.]c$")
    list(LENGTH _tls_initializers _tls_count)
    if(NOT _tls_count EQUAL 1)
        message(FATAL_ERROR "NCS heap initializer changed: review HTTPS allocator integration")
    endif()
    list(GET _tls_initializers 0 _tls_original)
    list(REMOVE_ITEM _tls_sources "${_tls_original}")
    list(APPEND _tls_sources "${CMAKE_CURRENT_SOURCE_DIR}/src/tls_allocator.c")
    set_property(TARGET mbedtls_zephyr PROPERTY SOURCES "${_tls_sources}")
    if(NOT CLIP_HTTPS_CA_FILE)
        set(CLIP_HTTPS_CA_FILE "$ENV{CLIP_HTTPS_CA_FILE}")
    endif()
    if(NOT CLIP_HTTPS_CA_FILE OR NOT EXISTS "${CLIP_HTTPS_CA_FILE}")
        message(FATAL_ERROR "Set CLIP_HTTPS_CA_FILE to the trusted test CA PEM (not a private key)")
    endif()
    file(READ "${CLIP_HTTPS_CA_FILE}" _ca_pem)
    if(NOT _ca_pem MATCHES "BEGIN CERTIFICATE" OR _ca_pem MATCHES "PRIVATE KEY")
        message(FATAL_ERROR "CLIP_HTTPS_CA_FILE must contain public CA certificate(s), not keys")
    endif()
    file(READ "${CLIP_HTTPS_CA_FILE}" _ca_hex HEX)
    string(REGEX REPLACE "(..)" "0x\\1," _ca_bytes "${_ca_hex}")
    file(WRITE "${PROJECT_BINARY_DIR}/https_ca.h"
        "static const unsigned char https_ca[] = {${_ca_bytes}0};\n")
    target_include_directories(app PRIVATE "${PROJECT_BINARY_DIR}")
    target_sources(app PRIVATE src/wifi_station.c src/https_poc.c)
else()
    target_sources(app PRIVATE src/wifi.c)
endif()
```

## Kconfig
```
#
# Copyright (c) 2025 Seeed Technology Co., Ltd.
#
# SPDX-License-Identifier: Apache-2.0
#

source "Kconfig.zephyr"

# Main application
menuconfig CLIP
	bool "Clip Application"
	default y

if CLIP

config CLIP_HTTPS_POC
	bool "Experimental USB-controlled HTTPS upload"
	default n
	help
	  Station-only, stopped-recording upload. Uses CDC-only USB and disables
	  application OTA during this experiment. Requires a supplied test CA.

module = CLIP
module-str = Clip Application
source "subsys/logging/Kconfig.template.log_config"

# =============================================================================
# Configuration Defaults
# =============================================================================

config CLIP_NORMAL_BITRATE
	int "Normal mode Opus bitrate (bps)"
	default 32000

config CLIP_NORMAL_COMPLEXITY
	int "Normal mode Opus complexity (0-10)"
	range 0 10
	default 1

config CLIP_ENHANCED_BITRATE
	int "Enhanced mode Opus bitrate (bps)"
	default 32000

config CLIP_ENHANCED_COMPLEXITY
	int "Enhanced mode Opus complexity (0-10)"
	range 0 10
	default 1

config CLIP_DEFAULT_NOISE
	int "Default noise suppression level (dB)"
	default 12

config CLIP_DEFAULT_DEREVERB
	bool "Default dereverberation enabled"
	default y

config CLIP_AGC_MAX_GAIN
	int "AGC maximum gain (dB)"
	default 60

config CLIP_AGC_TARGET
	int "AGC target level"
	default 30000

config CLIP_AGC_INCREMENT
	int "AGC max increase (dB/s)"
	default 60

config CLIP_AGC_DECREMENT
	int "AGC max decrease (dB/s)"
	default -100

config CLIP_STORAGE_FULL_PERCENT
	int "SD usage percent at which recording is refused (storage full)"
	default 95
	range 50 99
	help
	  Recording is refused and a "Storage Full" error is shown when SD card
	  usage reaches this percentage (e.g. 95 = refuse at 95% full).

config CLIP_LOG_FS_DEFAULT_ON
	bool "Enable FS (SD card) log backend by default at boot"
	default y if LOG_BACKEND_UART
	help
	  FS log default follows the UART log backend: debug builds (which keep
	  UART logging) default FS log on (INF to /SD:/LOG); the production
	  snippet disables UART logging, so FS log defaults off there. The FS
	  log can still be toggled at runtime with AT+LOG=off|info|debug.
	  Coupling to LOG_BACKEND_UART (rather than overriding this symbol from
	  the production snippet) avoids broadcasting an app-only Kconfig symbol
	  into the mcuboot sysbuild image, where it is undefined.

config CLIP_DEFAULT_AUTODEL
	int "Default auto-delete days (-1 for off)"
	default -1

config CLIP_DEFAULT_BRIGHTNESS
	int "Default OLED brightness (0-255)"
	default 32

config CLIP_DISPLAY_STATUS_TIMEOUT_MS
	int "Status bar display timeout (ms)"
	default 10000

config CLIP_DISPLAY_PAIRING_TIMEOUT_MS
	int "Pairing guide display timeout (ms)"
	default 60000

config CLIP_SETTINGS_LOAD_TIMEOUT_MS
	int "settings_load watchdog timeout (ms)"
	default 3000

config CLIP_SD_IDLE_DELAY_MS
	int "SD card idle power-off delay (ms)"
	default 45000

config CLIP_ADV_FAST_TIMEOUT_MS
	int "BLE fast advertising timeout before dropping to slow (ms)"
	default 30000

config CLIP_WIFI_AP_CHANNEL
	int "Default WiFi AP channel (5GHz: 36-165)"
	default 36

config CLIP_WIFI_AP_REG_DOMAIN
	string "Default WiFi regulatory domain (2-letter country code)"
	default "US"

# =============================================================================
# Hardware Configuration (crystal caps, low-battery boot gate)
# =============================================================================

config CLIP_HFXO_CAPVALUE
	int "HFXO (32 MHz) crystal capacitance (raw XOSC32MCAPS.CAPVALUE)"
	default 60
	help
	  Raw CAPVALUE register field for the 32 MHz crystal internal load caps.
	  Set by clip_xo_cap_init() (SYS_INIT POST_KERNEL) — the HFXO DTS binding
	  can't take a raw CAPVALUE (it derives from FICR), so we override here.
	  Tune with the tests/clip "hfxo set" shell, then set here.

config CLIP_LFXO_INTCAP
	int "LFXO (32.768 kHz) internal capacitance (0=ext, 1=6pF, 2=7pF, 3=9pF)"
	range 0 3
	default 1
	help
	  INTCAP for the 32.768 kHz crystal (XOSC32KI.INTCAP). 0 = external caps,
	  1 = 6 pF, 2 = 7 pF, 3 = 9 pF internal. Set by clip_xo_cap_init().

# =============================================================================
# Button Configuration
# =============================================================================

# =============================================================================
# Haptic Motor Configuration
# =============================================================================

config CLIP_HAPTIC_MOTOR_ENABLED
	bool "Enable haptic motor"
	default n

config CLIP_HAPTIC_MOTOR_GPIO_PIN
	int "Haptic motor GPIO pin"
	default 6

# =============================================================================
# AT Server Configuration
# =============================================================================

config CLIP_AT_SERVER_QUEUE_SIZE
	int "AT command queue size"
	default 10

config CLIP_AT_SERVER_STACK_SIZE
	int "AT server thread stack size"
	default 4096

config CLIP_AT_SERVER_PRIORITY
	int "AT server thread priority"
	default 7

config CLIP_AT_MAX_CMD_LEN
	int "Maximum AT command length"
	default 256

config CLIP_AT_MAX_RESPONSE_LEN
	int "Maximum AT response length"
	default 1024

# =============================================================================
# Audio Configuration
# =============================================================================

config CLIP_AUDIO_STACK_SIZE
	int "Audio thread stack size"
	default 32768

config CLIP_AUDIO_THREAD_PRIORITY
	int "Audio thread priority"
	default 0

config CLIP_AUDIO_ENABLED
	bool "Enable audio recording"
	default y

config CLIP_AUDIO_DMIC_FLUSH_FRAMES
	int "Number of DMIC frames to discard on start/resume"
	range 0 20
	default 4
	help
	  Number of 20ms DMIC frames to discard after mic power-on
	  to eliminate pop/click from power-up transients.

# =============================================================================
# Storage Configuration
# =============================================================================

config CLIP_STORAGE_ENABLED
	bool "Enable SD card storage"
	default y

config CLIP_STORAGE_MAX_SESSIONS
	int "Maximum number of sessions to list"
	default 100

config CLIP_STORAGE_SESSIONS_PER_PAGE
	int "Sessions per page for LIST command"
	default 20

config CLIP_STORAGE_MAX_CHUNKS
	int "Maximum chunks per session"
	default 9999

config CLIP_STORAGE_CHUNK_SIZE
	int "Storage chunk buffer size (bytes)"
	default 4096

config CLIP_STORAGE_FILES_PER_GROUP
	int "Number of files per group subdirectory"
	default 100
	help
	  Maximum number of audio files stored in each group subdirectory.
	  When a session has many files, they are organized into
	  subdirectories (0, 1, 2...) to maintain FAT filesystem performance.
	  Group = (file_index - 1) / FILES_PER_GROUP.

# =============================================================================
# Audio Segment Configuration
# =============================================================================

config CLIP_AUDIO_SEGMENT_DURATION_SYNC
	int "Audio segment duration during sync (seconds)"
	range 10 600
	default 60

config CLIP_AUDIO_SEGMENT_DURATION_NO_SYNC
	int "Audio segment duration without sync (seconds)"
	range 20 3600
	default 300

# =============================================================================
# Transfer Configuration
# =============================================================================

config CLIP_TRANSFER_ENABLED
	bool "Enable file transfer"
	default y

config CLIP_TRANSFER_STACK_SIZE
	int "Transfer thread stack size"
	default 16384

config CLIP_TRANSFER_THREAD_PRIORITY
	int "Transfer thread priority"
	default 5

config CLIP_TRANSFER_CHUNK_SIZE
	int "Transfer chunk size (bytes)"
	default 4096
	help
	  Data chunk size for file transfer. Transport layer slices into
	  multiple frames as needed (UDP max frame is 1024 bytes).
	  BLE transport will split into multiple notifications automatically.

# =============================================================================
# UDP Transport Configuration
# =============================================================================

config CLIP_UDP_THREAD_STACK_SIZE
	int "UDP server thread stack size"
	default 4096

config CLIP_UDP_THREAD_PRIORITY
	int "UDP server thread priority"
	default 5

config CLIP_UDP_RECV_BUF_SIZE
	int "UDP receive buffer size"
	default 2048

config CLIP_UDP_SOCKET_BUF_SIZE
	int "UDP socket SO_RCVBUF/SO_SNDBUF size"
	default 4096

config CLIP_UDP_MAX_DATA_SIZE
	int "UDP maximum data per packet"
	default 1024

config CLIP_UDP_HEARTBEAT_INTERVAL_MS
	int "UDP heartbeat interval (ms)"
	default 5000

config CLIP_UDP_CONNECTION_TIMEOUT_MS
	int "UDP connection timeout (ms)"
	default 30000

config CLIP_UDP_SEND_BACKOFF_US
	int "UDP send-error backoff (us), 0 to disable"
	default 1000
	help
	  Delay after a UDP sendto failure before the next frame. Only fires on an
	  actual send error (the socket is blocking, so this is rare), as a brief
	  drain window. 0 disables.

config CLIP_UDP_FILE_END_DELAY_US
	int "UDP delay before FILE_END (us), 0 to disable"
	default 5000
	help
	  Pause after the last DATA frame and before sending FILE_END. UDP is
	  unordered, so FILE_END sent right after the last DATA can overtake it
	  and make the client compute the file CRC before all DATA arrives (NACK).
	  Lets in-flight DATA land first. 0 disables.

config CLIP_UDP_REPAIR_PACE_US
	int "UDP inter-frame pace during retransmit (us), 0 to disable"
	default 1000
	help
	  Delay between retransmitted DATA frames when repairing a NACKed file
	  (selective repeat OR whole-file). The link just dropped frames, so pacing
	  the retransmit avoids re-overwhelming it. Halves each repair round (递减)
	  toward full speed as the file converges; the next file's initial send is
	  always full speed. 0 disables.

config CLIP_UDP_NACK_BACKOFF_MS
	int "UDP backoff between NACK retry rounds (ms)"
	default 10
	help
	  Delay before each NACK retransmit round, multiplied by the retry number
	  (10 ms, 20 ms, 30 ms ...). Lets the WiFi channel settle before resending.
	  Was 50; lowered — the heartbeat keep-alive makes the link stable, so a
	  long backoff just slows recovery.

# =============================================================================
# WiFi Configuration
# =============================================================================

config CLIP_WIFI_TIMEOUT_MS
	int "WiFi AP auto-off timeout (ms), 0 to disable"
	default 180000
	help
	  Time in milliseconds before WiFi AP is automatically disabled.
	  Timer starts after AP is enabled, restarts on client disconnect.
	  Set to 0 to disable auto-off.

config COEX_SEP_ANTENNAS
	bool "WiFi and BLE use separate antennas"
	default n

config SR_PROTOCOL_BLE
	bool "Short Range protocol is Bluetooth LE"
	default y
	help
	  Tells the WiFi/BLE coexistence PTA that the short-range
	  protocol is BLE, enabling proper radio arbitration.

# =============================================================================
# Battery / Fuel-Gauge Configuration
# =============================================================================

config CLIP_BATTERY_WIFI_LOAD_COMPENSATION
	bool "Compensate fuel gauge for WiFi (nRF70) current the NPM1300 IBAT cannot see"
	default y
	help
	  The nRF7002 main VDD (BUCKVBAT) is tied to VBAT upstream of the NPM1300,
	  so its radio TX/RX/internal-buck current never flows through the PMIC's
	  IBAT sense resistor. GAUGE_AVG_CURRENT therefore undercounts discharge
	  (and over-counts charge while charging) whenever WiFi is on, so the fuel
	  gauge SoC reads high. Fold a state-keyed WiFi-load estimate into the
	  current fed to nrf_fuel_gauge_process() to cancel the blind spot, in both
	  charge and discharge states. Disable only for an uncompensated baseline.

config CLIP_BATTERY_WIFI_AP_LOAD_MA
	int "Measured unseen nRF70 current with AP up, idle (mA)"
	default 59
	help
	  nRF7002 current (mA) drawn from VBAT-direct while the WiFi AP is up
	  but no file transfer is active (beaconing + radio standby). This is a
	  REAL draw the NPM1300 IBAT cannot see, so it must be billed to the
	  fuel gauge. Calibrate on the VBAT rail (upstream of the NPM1300):
	  unseen = total - |IBAT| with the AP up.

config CLIP_BATTERY_WIFI_TX_LOAD_MA
	int "Measured unseen nRF70 current during active UDP transfer (mA)"
	default 99
	help
	  nRF7002 current (mA) drawn from VBAT-direct while a WiFi UDP file
	  transfer is active (AP up + transfer). Calibrate the same way as
	  CLIP_BATTERY_WIFI_AP_LOAD_MA during an active transfer.

config CLIP_BATTERY_IDLE_CURRENT_UA
	int "Average battery current while idle, fed to the fuel gauge (uA)"
	default 400
	help
	  At idle the PMIC's one-shot IBAT sample is taken while the CPU runs the
	  60 s poll itself (mA-level draw, ~1.09 mA LSB) and integrating that
	  single sample over the whole 60 s delta over-counts discharge (~3%/h
	  phantom). Nordic's guidance for low-power periods is that the idle
	  current is known ahead of time: when not charging/recording/
	  transferring, this value is fed to nrf_fuel_gauge_process instead of
	  the measurement (and passed to nrf_fuel_gauge_idle_set). Calibrate from
	  the idle power budget (production ~170 uA + BLE advertising + OLED
	  wakeups).

config CLIP_BATTERY_DISPLAY_MAX_STEP
	int "Max displayed SoC change per poll (%)"
	default 3
	help
	  Rate-limits the DISPLAYED state-of-charge toward the fuel-gauge value,
	  DIRECTIONALLY, polled every 60 s: while charging the display only moves
	  UP toward the gauge (catch up + track the charge); while discharging it
	  only moves DOWN (track depletion). A normal charge/discharge changes by
	  <= MAX_STEP per poll, so the display tracks it with ZERO lag. The gauge's
	  voltage-reconciliation up-correction (the ~5-15% first-reboot jump after
	  charge/discharge cycling) is therefore held while discharging (no upward
	  creep on a discharging battery) and only corrected on the next charge.
	  Set 0 to disable smoothing (display the raw gauge SoC directly). The
	  displayed value is persisted across reboot so it resumes from the value
	  shown before reboot (no cross-reboot lag accumulation).

# =============================================================================
# Debug Configuration
# =============================================================================

config CLIP_DEBUG_STATS
	bool "Enable periodic thread stack and heap usage logging"
	default n
	help
	  Print thread stack usage and heap stats every 10 seconds.

endif # CLIP
```

## sysbuild.conf
```
# Experimental external nRF7002 patch storage (ordinary SPI NOR, not XIP).
# The patch must be provisioned separately before enabling Wi-Fi. See
# docs/wifi-patch-external-flash.md for partition migration and test limits.
SB_CONFIG_WIFI_NRF70=y
SB_CONFIG_WIFI_PATCHES_EXT_FLASH_STORE=y
# Factory-provisioned patch experiment: retain the existing two-image bootloader.
SB_CONFIG_CLIP_WIFI_PATCH_FACTORY_ONLY=y
SB_CONFIG_DFU_ZIP_WIFI_FW_PATCH=n
```

## prj.conf
```kconfig
# SPDX-License-Identifier: Apache-2.0
#
# Clip Application Configuration
# Refactored version with modular architecture
#

# ==============================================================================
# FPU + CMSIS-DSP
# ==============================================================================
CONFIG_FPU=y
CONFIG_FPU_SHARING=y
CONFIG_CMSIS_DSP=y

# ==============================================================================
# Logging Configuration
# ==============================================================================
CONFIG_LOG=y
CONFIG_ASSERT=n
CONFIG_CLIP_LOG_LEVEL_INF=y
CONFIG_LOG_DEFAULT_LEVEL=0
CONFIG_LOG_MODE_DEFERRED=y
CONFIG_LOG_RUNTIME_FILTERING=y
CONFIG_LOG_BUFFER_SIZE=8192
CONFIG_LOG_PROCESS_THREAD=y

# FS log backend (SD card /SD:/LOG/)
CONFIG_LOG_BACKEND_FS=y
CONFIG_LOG_BACKEND_FS_DIR="/SD:/LOG"
CONFIG_LOG_BACKEND_FS_FILE_PREFIX="log."
CONFIG_LOG_BACKEND_FS_FILE_SIZE=131072
CONFIG_LOG_BACKEND_FS_FILES_LIMIT=20
CONFIG_LOG_BACKEND_FS_OVERWRITE=y
CONFIG_LOG_BACKEND_FS_APPEND_TO_NEWEST_FILE=y

# Minimize log output overhead
CONFIG_LOG_BACKEND_SHOW_COLOR=n
CONFIG_LOG_PRINTK=n

# Disable validation features to save flash
CONFIG_SPIN_VALIDATE=n
CONFIG_MEM_SLAB_POINTER_VALIDATE=n

# ==============================================================================
# Main Stack and Heap
# ==============================================================================
CONFIG_MAIN_STACK_SIZE=6144
CONFIG_HEAP_MEM_POOL_SIZE=81920
CONFIG_CLIP_AT_SERVER_STACK_SIZE=8192
CONFIG_CLIP_TRANSFER_STACK_SIZE=4096
CONFIG_CLIP_UDP_THREAD_STACK_SIZE=2048

# ==============================================================================
# Reboot Support
# ==============================================================================
CONFIG_REBOOT=y

# ==============================================================================
# Power Management (System ON Idle)
# ==============================================================================
CONFIG_PM=y
CONFIG_PM_DEVICE=y
CONFIG_PM_DEVICE_RUNTIME=y
CONFIG_TICKLESS_KERNEL=y

# ==============================================================================
# Thread Monitoring (disabled to save ~20KB flash)
# ==============================================================================
CONFIG_THREAD_MONITOR=n
CONFIG_THREAD_NAME=n
CONFIG_THREAD_RUNTIME_STATS=n
CONFIG_THREAD_RUNTIME_STATS_USE_TIMING_FUNCTIONS=n
CONFIG_INIT_STACKS=n
CONFIG_STACK_SENTINEL=n
CONFIG_SYS_HEAP_RUNTIME_STATS=n

# DWT cycle counter for precise timing measurement
CONFIG_CORTEX_M_DWT=y

# Debug stats (thread stack + heap usage)
CONFIG_CLIP_DEBUG_STATS=n

# ==============================================================================
# Retention subsystem for MCUboot USB DFU mode trigger
# ==============================================================================
CONFIG_RETAINED_MEM=y
CONFIG_RETENTION=y
CONFIG_RETENTION_BOOT_MODE=y

# ==============================================================================
# Bluetooth BLE Configuration (minimal for OTA)
# ==============================================================================
CONFIG_BT=y
CONFIG_BT_PERIPHERAL=y
CONFIG_BT_DEVICE_NAME="Clip"
CONFIG_BT_DEVICE_NAME_DYNAMIC=y
CONFIG_BT_MAX_CONN=1

# BLE throughput optimization
CONFIG_BT_BUF_ACL_RX_SIZE=517
CONFIG_BT_BUF_ACL_TX_SIZE=517
CONFIG_BT_L2CAP_TX_MTU=517
CONFIG_BT_GATT_CLIENT=y
CONFIG_BT_RX_STACK_SIZE=4096

# BLE Pairing & Bonding
CONFIG_BT_SMP=y
CONFIG_BT_BONDABLE=y
CONFIG_BT_MAX_PAIRED=1
# Debug: a new phone may pair and overwrite the single stored bond without
# first clearing it (convenient for testing). Production turns this OFF in
# snippets/production/snippet-production.conf so the device stays locked to
# its owner until an explicit AT+PAIR=reset.
CONFIG_BT_KEYS_OVERWRITE_OLDEST=y
CONFIG_BT_SETTINGS=y
CONFIG_BT_FILTER_ACCEPT_LIST=y
CONFIG_BT_GATT_SERVICE_CHANGED=y
CONFIG_BT_GATT_CACHING=y
CONFIG_BT_ASSERT_VERBOSE=n

# ==============================================================================
# GPIO and Regulators
# ==============================================================================
CONFIG_GPIO=y
CONFIG_REGULATOR=y

# Custom GPIO button driver
CONFIG_GPIO_BUTTON=y
CONFIG_INPUT_GPIO_BUTTON_OWN_THREAD=y
CONFIG_INPUT_GPIO_BUTTON_THREAD_STACK_SIZE=512
CONFIG_INPUT_GPIO_BUTTON_THREAD_PRIORITY=5

# Haptic motor control
CONFIG_CLIP_HAPTIC_MOTOR_ENABLED=y

# Display
CONFIG_DISPLAY=y

# I2C for PMIC and Display
CONFIG_I2C=y

# MFD and npm1300 charger/fuel-gauge sensor (required for SD card power)
CONFIG_MFD=y
CONFIG_SENSOR=y
CONFIG_NPM13XX_CHARGER=y

# Nordic nRF Fuel Gauge Library for accurate battery SoC estimation
CONFIG_NRF_FUEL_GAUGE=y
CONFIG_NRF_FUEL_GAUGE_VARIANT_SECONDARY_CELL=y

# BLE Battery Service
CONFIG_BT_BAS=y
CONFIG_BT_BAS_BLS=y
CONFIG_BT_BAS_BLS_BATTERY_LEVEL_PRESENT=y
CONFIG_BT_BAS_BLS_ADDITIONAL_STATUS_PRESENT=y

# ==============================================================================
# Settings and Storage
# ==============================================================================
CONFIG_FLASH=y
CONFIG_FLASH_MAP=y
CONFIG_SETTINGS=y

# File Systems
CONFIG_FILE_SYSTEM=y

# LittleFS for settings
CONFIG_FILE_SYSTEM_LITTLEFS=y
CONFIG_FS_LITTLEFS_FMP_DEV=y
CONFIG_FS_LITTLEFS_FC_HEAP_SIZE=4096
CONFIG_FS_LITTLEFS_NUM_FILES=16
CONFIG_FS_LITTLEFS_NUM_DIRS=4

# FATFS for SD card
CONFIG_FAT_FILESYSTEM_ELM=y
CONFIG_FS_FATFS_LFN=y
CONFIG_FS_FATFS_LFN_MODE_HEAP=y
CONFIG_FS_FATFS_REENTRANT=y
CONFIG_DISK_ACCESS=y
CONFIG_DISK_DRIVER_SDMMC=y

CONFIG_SETTINGS_FILE=y
CONFIG_SETTINGS_FILE_PATH="/lfs/settings/run"
CONFIG_SETTINGS_FILE_MAX_LINES=16

# ==============================================================================
# Bluetooth OTA DFU (MCUmgr) - App core + Network core
# ==============================================================================
CONFIG_NCS_SAMPLE_MCUMGR_BT_OTA_DFU=y
CONFIG_MCUMGR_GRP_IMG_UPDATABLE_IMAGE_NUMBER=2
CONFIG_MCUMGR_MGMT_NOTIFICATION_HOOKS=y
CONFIG_MCUMGR_GRP_IMG_STATUS_HOOKS=y
CONFIG_MCUMGR_GRP_IMG_UPLOAD_CHECK_HOOK=y

CONFIG_SYSTEM_WORKQUEUE_STACK_SIZE=4096

CONFIG_NEWLIB_LIBC=y
CONFIG_NEWLIB_LIBC_NANO=y

# ==============================================================================
# Flash Size Optimization (-Oz)
# ==============================================================================
CONFIG_NO_OPTIMIZATIONS=n
CONFIG_DEBUG_OPTIMIZATIONS=n
CONFIG_SPEED_OPTIMIZATIONS=n
CONFIG_SIZE_OPTIMIZATIONS=n
CONFIG_SIZE_OPTIMIZATIONS_AGGRESSIVE=y

# Link Time Optimization
CONFIG_ISR_TABLES_LOCAL_DECLARATION=y
CONFIG_LTO=y

# ==============================================================================
# Audio Configuration (DMIC + Opus + SpeexDSP)
# ==============================================================================
CONFIG_CLIP_AUDIO_ENABLED=y

# DMIC (PDM Microphone)
CONFIG_AUDIO=y
CONFIG_AUDIO_DMIC=y

# Opus Codec
CONFIG_OPUS_CODEC=y

# SpeexDSP for audio preprocessing (noise suppression, AGC, dereverb)
# Only used in enhanced/merge mode, not in stereo mode
CONFIG_SPEEXDSP=y

# Thread stack for audio (needs more space for Opus encoding)
CONFIG_CLIP_AUDIO_STACK_SIZE=32768
CONFIG_CLIP_AUDIO_THREAD_PRIORITY=0

# =============================================================================
# Audio Segment Duration (configured via Kconfig, not hardcoded here)
# Use CLIP_AUDIO_SEGMENT_DURATION_SYNC and CLIP_AUDIO_SEGMENT_DURATION_NO_SYNC
# from Kconfig to set these values (default: 60s and 300s)
# =============================================================================
CONFIG_CLIP_AUDIO_SEGMENT_DURATION_SYNC=60
CONFIG_CLIP_AUDIO_SEGMENT_DURATION_NO_SYNC=300

CONFIG_CLIP_STORAGE_FILES_PER_GROUP=100

# ==============================================================================
# WiFi AP Configuration
# ==============================================================================
# nRF7002 firmware patches stored on external SPI flash via sysbuild.conf.
# Load in small chunks; retain SDK SHA-256 integrity verification.
# ==============================================================================
CONFIG_NRF_WIFI_FW_FLASH_CHUNK_SIZE=2048
CONFIG_NRF_WIFI_FW_PATCH_INTEGRITY_CHECK=y
CONFIG_WIFI=y
CONFIG_WIFI_NRF70=y
CONFIG_NRF70_AP_MODE=y

# WiFi/BLE coexistence: MPSL_CX=y on net core + NRF70_SR_COEX=y on app core.
# NRF70_SR_COEX_RF_SWITCH is NOT enabled (no RF switch hardware on this board).
CONFIG_NRF70_SR_COEX=y
CONFIG_WIFI_NM_WPA_SUPPLICANT=y
CONFIG_WIFI_NM_WPA_SUPPLICANT_AP=y
# Suppress WPA supplicant log strings (saves ~10KB flash)
CONFIG_WIFI_NM_WPA_SUPPLICANT_LOG_LEVEL_ERR=y
# Disable WPA3/SAE — device uses WPA2-PSK only (saves ~23KB flash)
CONFIG_WIFI_NM_WPA_SUPPLICANT_WPA3_IMPLEMENTATION_NONE=y

# AP-only mode — STA infrastructure required by AP code, cannot disable
# CONFIG_NRF70_STA_MODE=n

# Crypto: SHA512/DHM disable caused sta_set_flags errors, keep enabled for now
# CONFIG_MBEDTLS_SHA512_C=n
# CONFIG_MBEDTLS_SHA384_C=n
# CONFIG_MBEDTLS_DHM_C=n
CONFIG_WIFI_RANDOM_MAC_ADDRESS=y

# WiFi ready callback library (for runtime net_if_up)
CONFIG_WIFI_READY_LIB=y

# WiFi driver manual start (user must call net_if_up before AP mode)
# This saves ~30mA when WiFi is not in use.
CONFIG_NRF_WIFI_IF_AUTO_START=n

# QSPI low power mode (saves ~0.1-0.3mA when WiFi is off)
CONFIG_NRF70_QSPI_LOW_POWER=y

# Minimal networking stack (IPv4 + UDP + DHCP, no IPv6/TCP)
CONFIG_NETWORKING=y
CONFIG_NET_L2_ETHERNET=y
CONFIG_NET_L2_WIFI_MGMT=y
CONFIG_NET_IPV4=y
CONFIG_NET_IPV6=n
CONFIG_NET_UDP=y
CONFIG_NET_TCP=n
CONFIG_NET_SOCKETS=y
CONFIG_NET_DHCPV4=y
CONFIG_NET_DHCPV4_SERVER=y
CONFIG_NET_DHCPV4_SERVER_ADDR_COUNT=1
CONFIG_NET_MGMT=y
CONFIG_NET_MGMT_EVENT=y
CONFIG_NET_CONFIG_SETTINGS=y
CONFIG_NET_CONFIG_INIT_TIMEOUT=0
CONFIG_NET_LOG=n

# AP static IP
CONFIG_NET_IF_UNICAST_IPV4_ADDR_COUNT=1
CONFIG_NET_CONFIG_MY_IPV4_ADDR="192.168.4.1"
CONFIG_NET_CONFIG_MY_IPV4_NETMASK="255.255.255.0"
CONFIG_NET_CONFIG_MY_IPV4_GW="192.168.4.1"

CONFIG_MBEDTLS_HEAP_SIZE=1024


# Minimal WiFi buffer sizes (tune for RAM/flash balance)
CONFIG_NET_PKT_RX_COUNT=8
CONFIG_NET_PKT_TX_COUNT=24
CONFIG_NET_BUF_RX_COUNT=16
CONFIG_NET_BUF_TX_COUNT=32
CONFIG_NET_PKT_BUF_TX_DATA_POOL_SIZE=16384
CONFIG_CLIP_UDP_SOCKET_BUF_SIZE=4096
CONFIG_NRF70_RX_NUM_BUFS=8
CONFIG_NRF70_MAX_TX_AGGREGATION=4
CONFIG_NRF_WIFI_CTRL_HEAP_SIZE=20000
CONFIG_NRF_WIFI_DATA_HEAP_SIZE=40000

CONFIG_NET_TC_TX_COUNT=1
CONFIG_NET_IF_UNICAST_IPV4_ADDR_COUNT=1
CONFIG_NET_MAX_CONTEXTS=8
CONFIG_NET_MAX_CONN=6
CONFIG_NET_CONTEXT_SYNC_RECV=y
CONFIG_NET_CONFIG_SETTINGS=y
CONFIG_NET_CONFIG_INIT_TIMEOUT=0
CONFIG_NET_SOCKETS_POLL_MAX=4
CONFIG_NET_TCP_TIME_WAIT_DELAY=0
CONFIG_NET_TCP_WORKQ_STACK_SIZE=2048

CONFIG_NET_RX_STACK_SIZE=2048
CONFIG_NET_TX_STACK_SIZE=2048

CONFIG_NRF70_IRQ_WQ_STACK_SIZE=1024

CONFIG_WIFI_NM_WPA_SUPPLICANT_THREAD_STACK_SIZE=10240
CONFIG_WIFI_NM_WPA_SUPPLICANT_WQ_STACK_SIZE=2048

# Required by WPA supplicant
CONFIG_POSIX_TIMERS=y
CONFIG_ENTROPY_GENERATOR=y

# Hardware info for SSID generation from chip ID
CONFIG_HWINFO=y

# ==============================================================================
# USB - CDC ACM (AT command serial) + MSC (SD card, on demand)
# ==============================================================================
CONFIG_USB_DEVICE_STACK_NEXT=y

# 1200-baud USB CDC -> mcuboot DFU trigger (hook is on via the board default
# CONFIG_CLIP_USB_DFU=y). The clip app brings its own BLE-gated CDC+MSC, so
# disable the module's default CDC (which is for apps without a USB stack).
CONFIG_CLIP_USB_DFU_DEFAULT_CDC=n

# CDC ACM (virtual serial port for AT commands)
CONFIG_USBD_CDC_ACM_CLASS=y
CONFIG_SERIAL=y
CONFIG_UART_INTERRUPT_DRIVEN=y
CONFIG_UART_LINE_CTRL=y

# MSC (Mass Storage, enabled via AT+MSC=on)
CONFIG_USBD_MSC_CLASS=y
CONFIG_USBD_MSC_LUNS_PER_INSTANCE=1
CONFIG_USBD_MSC_DOUBLE_BUFFERING=n
CONFIG_USBD_MSC_SCSI_BUFFER_SIZE=512
CONFIG_USBD_MSC_STACK_SIZE=1024
```

## https-measure.conf
```kconfig
# Append after https.conf for a separate measurement build.
CONFIG_SYS_HEAP_RUNTIME_STATS=y
CONFIG_INIT_STACKS=y
CONFIG_THREAD_STACK_INFO=y
```

## https.conf
```kconfig
# App-only overlay: do not apply to MCUboot or the network core.
CONFIG_CLIP_HTTPS_POC=y
CONFIG_NRF70_AP_MODE=n
CONFIG_WIFI_NM_WPA_SUPPLICANT_AP=n
CONFIG_NET_DHCPV4_SERVER=n
CONFIG_NET_CONFIG_MY_IPV4_ADDR=""
CONFIG_NET_CONFIG_MY_IPV4_GW=""
CONFIG_NET_TCP=y
CONFIG_DNS_RESOLVER=y
CONFIG_NET_SOCKETS_DNS_TIMEOUT=5000
CONFIG_NET_SOCKETS_SOCKOPT_TLS=y
# This SDK's TLS connect blocks even with O_NONBLOCK. Bound TCP and TLS
# separately; their combined wait stays below the 30-second connect budget.
CONFIG_NET_SOCKETS_CONNECT_TIMEOUT=3000
CONFIG_NET_SOCKETS_TLS_CONNECT_TIMEOUT=10000
CONFIG_NET_SOCKETS_TLS_MAX_CONTEXTS=1
CONFIG_HTTP_CLIENT=y
CONFIG_JSON_LIBRARY=y
CONFIG_MBEDTLS=y
# TLS uses the existing system heap through tls_allocator.c. Its peak must
# be measured on hardware; do not reserve a second 24 KiB static heap.
CONFIG_MBEDTLS_ENABLE_HEAP=y
CONFIG_MBEDTLS_SSL_IN_CONTENT_LEN=4096
CONFIG_MBEDTLS_SSL_OUT_CONTENT_LEN=4096
CONFIG_MBEDTLS_SSL_PROTO_TLS1_2=y
CONFIG_MBEDTLS_SSL_SRV_C=n
CONFIG_MBEDTLS_X509_CRL_PARSE_C=n
CONFIG_MBEDTLS_X509_CSR_PARSE_C=n
CONFIG_MBEDTLS_PEM_PARSE_C=y
# CDC-only leaves the SD card owned by the device.
CONFIG_USBD_MSC_CLASS=n
```

## src/main.c
```c
/*
 * Copyright (c) 2025 Seeed Technology Co., Ltd.
 *
 * SPDX-License-Identifier: Apache-2.0
 */

#include <zephyr/kernel.h>
#include <zephyr/logging/log.h>
#include <zephyr/logging/log_backend.h>
#include <zephyr/logging/log_ctrl.h>
#include <zephyr/drivers/regulator.h>
#include <app_version.h>
#include <zephyr/sys/util.h>
#include <zephyr/sys/mem_stats.h>
#include <zephyr/sys/sys_heap.h>

#include <nrfx_clock.h>
#include <hal/nrf_oscillators.h>

#include "clip.h"
#include "config.h"
#include "ble.h"
#include "transport.h"
#include "transport_ble.h"
#include "at_server.h"
#include "at_commands.h"
#include "audio.h"
#include "storage.h"
#include "transfer.h"
#include "button.h"
#include "display.h"
#include "wifi.h"
#include "wifi_udp.h"
#include "transport_udp.h"
#include "clip_event.h"
#include "battery.h"
#include "haptic.h"
#include "usb_cdc.h"

LOG_MODULE_REGISTER(main, CONFIG_CLIP_LOG_LEVEL);

/* Global context */
static struct clip_context g_ctx;

struct clip_context *clip_get_context(void)
{
    return &g_ctx;
}

const char *clip_state_to_string(enum clip_state state)
{
    switch (state) {
    case CLIP_STATE_UNINITIALIZED:
        return "UNINITIALIZED";
    case CLIP_STATE_IDLE:
        return "IDLE";
    case CLIP_STATE_RECORDING:
        return "RECORDING";
    case CLIP_STATE_TRANSMITTING:
        return "TRANSMITTING";
    case CLIP_STATE_WIFI_SYNC:
        return "WIFI_SYNC";
    case CLIP_STATE_PAUSED:
        return "PAUSED";
    case CLIP_STATE_ERROR:
        return "ERROR";
    case CLIP_STATE_OTA:
        return "OTA";
    default:
        return "UNKNOWN";
    }
}

bool clip_get_current_time(uint16_t *out_year, uint8_t *out_month, uint8_t *out_day,
                           uint8_t *out_hour, uint8_t *out_min, uint8_t *out_sec)
{
    uint32_t sec;

    if (!g_ctx.time.valid) {
        return false;
    }

    /* Calculate elapsed time since sync */
    int64_t current_uptime = k_uptime_get();
    int64_t elapsed_ms = current_uptime - g_ctx.time.base_uptime_ms;

    if (elapsed_ms < 0) {
        elapsed_ms = 0;
    }

    /* Convert to seconds */
    uint32_t elapsed_sec = (uint32_t)(elapsed_ms / 1000);

    /* Start from synced time */
    uint16_t year = g_ctx.time.year;
    uint8_t month = g_ctx.time.month;
    uint8_t day = g_ctx.time.day;
    uint8_t hour = g_ctx.time.hour;
    uint8_t min = g_ctx.time.min;
    sec = g_ctx.time.sec;

    /* Add elapsed seconds */
    sec += elapsed_sec;

    /* Handle overflow */
    while (sec >= 60) {
        sec -= 60;
        min++;
    }
    while (min >= 60) {
        min -= 60;
        hour++;
    }
    while (hour >= 24) {
        hour -= 24;
        day++;
    }

    /* Simple day overflow handling */
    uint8_t days_in_month[] = {31, 28, 31, 30, 31, 30, 31, 31, 30, 31, 30, 31};
    if ((year % 4 == 0 && year % 100 != 0) || (year % 400 == 0)) {
        days_in_month[1] = 29;
    }

    while (day > days_in_month[month - 1]) {
        day -= days_in_month[month - 1];
        month++;
        if (month > 12) {
            month = 1;
            year++;
        }
    }

    *out_year = year;
    *out_month = month;
    *out_day = day;
    *out_hour = hour;
    *out_min = min;
    *out_sec = (uint8_t)sec;

    return true;
}

int clip_init(void)
{
    int err;


    /* Initialize context */

    /* Initialize configuration (will set defaults and load from storage) */
    err = config_init();
    if (err) {
        LOG_WRN("Config init failed: %d, using defaults", err);
        /* Continue anyway - config is optional */
    }

    /* Initialize battery monitoring before display so first render has real data */
    err = battery_init();
    if (err) {
        LOG_WRN("Battery init failed: %d", err);
        /* Continue anyway - battery is optional */
    }

    /* Initialize haptic motor before display (boot animation uses it) */
    err = haptic_init();
    if (err) {
        LOG_WRN("Haptic init failed: %d", err);
    }

    /* Initialize display early (before slow BLE init) to light up screen */
    err = display_init();
    if (err) {
        LOG_WRN("Display init failed: %d", err);
        /* Continue anyway - display is optional */
    }

    /* Start boot animation (runs in background while init continues) */
    display_boot_animation_start();

    /* Initialize BLE (bt_enable is slow, display is already showing) */
    err = ble_init();
    if (err) {
        LOG_ERR("BLE init failed: %d", err);
        return err;
    }

    /* Initialize transport layer */
    err = transport_init();
    if (err) {
        LOG_ERR("Transport init failed: %d", err);
        return err;
    }

    /* Initialize BLE transport (now that BLE is ready) */
    err = transport_ble_init();
    if (err) {
        LOG_ERR("BLE transport init failed: %d", err);
        return err;
    }

    /* Register BLE transport */
    err = transport_register(transport_ble_get());
    if (err) {
        LOG_ERR("BLE transport register failed: %d", err);
        return err;
    }

    /* Initialize UDP transport */
    err = transport_udp_init();
    if (err) {
        LOG_WRN("UDP transport init failed: %d", err);
        /* Continue anyway - UDP is optional */
    }

    /* Register UDP transport */
    err = transport_register(transport_udp_get());
    if (err) {
        LOG_WRN("UDP transport register failed: %d", err);
        /* Continue anyway - UDP is optional */
    }

    /* Initialize audio subsystem */
    err = audio_init();
    if (err) {
        LOG_ERR("Audio init failed: %d", err);
        return err;
    }

    /* Initialize storage subsystem */
    err = storage_init();
    if (err) {
        LOG_WRN("Storage init failed: %d", err);
        /* Continue anyway - storage is optional */
    } else {
        /* SD card mounted - check for unsynced sessions */
        display_check_untransferred();

#ifdef CONFIG_LOG_BACKEND_FS
        const struct log_backend *fs_be = log_backend_get_by_name("log_backend_fs");
        if (fs_be) {
            if (IS_ENABLED(CONFIG_CLIP_LOG_FS_DEFAULT_ON)) {
                /* Debug: FS log on by default (WRN+ERR to /SD:/LOG) */
                log_backend_activate(fs_be, NULL);
                uint32_t src_cnt = log_src_cnt_get(0);
                for (uint32_t i = 0; i < src_cnt; i++) {
                    log_filter_set(fs_be, 0, (int16_t)i, LOG_LEVEL_INF);
                }
            } else {
                /* Production: FS log off (enable via AT+LOG) */
                log_backend_deactivate(fs_be);
            }
        }
#endif
    }

    /* Initialize USB CDC ACM + MSC (serial port + SD card drive) */
    err = usb_cdc_init();
    if (err) {
        LOG_WRN("USB init failed: %d", err);
    }

    /* Initialize transfer subsystem */
    err = transfer_init();
    if (err) {
        LOG_WRN("Transfer init failed: %d", err);
        /* Continue anyway - transfer is optional */
    }

    /* Initialize WiFi subsystem */
    err = wifi_init();
    if (err) {
        LOG_WRN("WiFi init failed: %d", err);
        /* Continue anyway - WiFi is optional */
    }

    /* Initialize WiFi UDP server */
    err = wifi_udp_init();
    if (err) {
        LOG_WRN("WiFi UDP init failed: %d", err);
        /* Continue anyway - UDP is optional */
    }

    /* Register AT commands BEFORE starting server thread */
    err = at_commands_register();
    if (err) {
        LOG_ERR("AT commands register failed: %d", err);
        return err;
    }

    /* Initialize AT server (commands must be registered first) */
    err = at_server_init();
    if (err) {
        LOG_ERR("AT server init failed: %d", err);
        return err;
    }

    /* Initialize button handler */
    err = button_init();
    if (err) {
        LOG_WRN("Button init failed: %d", err);
        /* Continue anyway - button is optional */
    }

    /* Initialize event dispatcher (depends on audio, haptic, display, wifi) */
    err = clip_event_init();
    if (err) {
        LOG_ERR("Event dispatcher init failed: %d", err);
        return err;
    }

#ifdef CONFIG_CLIP_HTTPS_POC
    err = usb_cdc_enable();
    if (err) { return err; }
#endif

    /* Clear status (battery_percent/charging set by battery_init) */
    g_ctx.status.recording_time = 0;
    g_ctx.status.free_space = 0;
    g_ctx.status.session_count = 0;

    /* Transition to idle state */
    clip_event_get_state();  /* Already set by clip_event_init */

    LOG_INF("ready: normal=%u/%u enhanced=%u/%u",
           CONFIG_CLIP_NORMAL_BITRATE, CONFIG_CLIP_NORMAL_COMPLEXITY,
           CONFIG_CLIP_ENHANCED_BITRATE, CONFIG_CLIP_ENHANCED_COMPLEXITY);

    return 0;
}

extern struct k_heap _system_heap;

static void thread_stack_stats_cb(const struct k_thread *thread, void *user_data)
{
	ARG_UNUSED(user_data);

	size_t stack_size, free_bytes;

#ifdef CONFIG_THREAD_STACK_INFO
	stack_size = thread->stack_info.size;
	if (k_thread_stack_space_get(thread, &free_bytes) == 0) {
		size_t used = stack_size - free_bytes;
		const char *name = k_thread_name_get(
			(struct k_thread *)thread);
		if (!name || name[0] == '\0') {
			name = "?";
		}
		LOG_INF("  %-20s %5u/%5u (%2u%%)",
			name, used, stack_size,
			stack_size > 0 ? (uint32_t)(used * 100 / stack_size) : 0);
	}
#endif
}

void clip_main_loop(void)
{

    int stats_counter = 0;

    while (true) {
        /* Use K_FOREVER when not recording to allow deep idle;
         * use 1s timeout during recording for time tracking */
        k_timeout_t wait = (clip_event_get_state() == CLIP_STATE_RECORDING)
                           ? K_MSEC(1000) : K_FOREVER;
        clip_event_wait(wait);

        /* Process all pending events */
        clip_event_process();

        /* Update recording time if recording */
        if (clip_event_get_state() == CLIP_STATE_RECORDING) {
            g_ctx.status.recording_time++;
        }

        /* Print thread stack stats every 10 seconds */
        if (IS_ENABLED(CONFIG_CLIP_DEBUG_STATS) && ++stats_counter >= 10) {
            stats_counter = 0;

            LOG_INF("--- Thread Stack Usage ---");
            k_thread_foreach(thread_stack_stats_cb, NULL);

            /* Heap usage */
            struct sys_memory_stats hs;
            if (sys_heap_runtime_stats_get(&_system_heap.heap, &hs) == 0) {
                LOG_INF("  HEAP: %u/%u used (peak %u)",
                        hs.allocated_bytes,
                        hs.allocated_bytes + hs.free_bytes,
                        hs.max_allocated_bytes);
            }
        }
    }
}

/*
 * Crystal load-capacitor tuning.
 *
 * The board has no external load capacitors for the HFXO (32 MHz) or LFXO
 * (32.768 kHz); the internal ones must be enabled through the OSCILLATORS
 * peripheral. The values below were tuned with the tests/clip `hfxo`/`lfxo`
 * shell and are written here the same way — as raw register fields, not via
 * the DTS femtofarad/picofarad properties (the HFXO DTS binding cannot take a
 * raw CAPVALUE; it derives one from per-chip FICR, which is not what we want).
 *
 * SoC init writes these registers once at boot (PRE_KERNEL) from the DTS;
 * this runs afterwards (POST_KERNEL) and overrides with the tuned values.
 * Neither register is touched again at runtime, so the override sticks.
 */
static int clip_xo_cap_init(void)
{
	NRF_OSCILLATORS->XOSC32MCAPS =
		(OSCILLATORS_XOSC32MCAPS_ENABLE_Enabled <<
		 OSCILLATORS_XOSC32MCAPS_ENABLE_Pos) |
		(CONFIG_CLIP_HFXO_CAPVALUE << OSCILLATORS_XOSC32MCAPS_CAPVALUE_Pos);
	NRF_OSCILLATORS->XOSC32KI.INTCAP = CONFIG_CLIP_LFXO_INTCAP;
	return 0;
}
SYS_INIT(clip_xo_cap_init, POST_KERNEL, 0);

int main(void)
{
    /* Print version and build info at startup */
    LOG_INF("Clip Firmware v%s", CLIP_VERSION);
    LOG_INF("Build: %s %s", __DATE__, __TIME__);

    int err;

    /* Initialize application */
    err = clip_init();
    if (err) {
        LOG_ERR("Application init failed: %d", err);
        return err;
    }

    /* Enter main loop */
    clip_main_loop();

    return 0;
}
```

## include/clip_event.h
```c
/*
 * Copyright (c) 2025 Seeed Technology Co., Ltd.
 *
 * SPDX-License-Identifier: Apache-2.0
 *
 * Central event dispatcher for CLIP device.
 *
 * Button presses and AT commands post events here.
 * The event handler validates state transitions, updates state,
 * and triggers all side effects (audio, haptic, display).
 */

#ifndef CLIP_EVENT_H
#define CLIP_EVENT_H

#include <zephyr/kernel.h>
#include "clip.h"

/**
 * @brief Device-level events from user input or AT commands.
 */
enum clip_event {
    CLIP_EVENT_START = 0,
    CLIP_EVENT_STOP,
    CLIP_EVENT_PAUSE,
    CLIP_EVENT_RESUME,
    CLIP_EVENT_MARK,
    CLIP_EVENT_WIFI_ON,
    CLIP_EVENT_WIFI_OFF,
    CLIP_EVENT_POWER_OFF_SHOW,
    CLIP_EVENT_POWER_OFF_EXEC,
    CLIP_EVENT_STATUS_SHOW,
    CLIP_EVENT_USB_CONNECTED,
    CLIP_EVENT_OTA_START,
    CLIP_EVENT_OTA_DONE,
    CLIP_EVENT_UPLOAD_BEGIN,
    CLIP_EVENT_UPLOAD_END,
    CLIP_EVENT_COUNT,
};

/**
 * @brief Event result codes
 */
enum clip_event_result {
    CLIP_EVENT_OK = 0,
    CLIP_EVENT_INVALID,
    CLIP_EVENT_BUSY,
    CLIP_EVENT_ERROR,
};

/**
 * @brief Event handler result info (for sync callers)
 */
struct clip_event_result_info {
    enum clip_event_result result;
    int error_code;
};

/**
 * @brief Post an event (non-blocking, for button presses)
 */
int clip_post_event(enum clip_event event);

/**
 * @brief Post an event and wait for result (blocking, for AT commands)
 */
int clip_post_event_sync(enum clip_event event,
                         struct clip_event_result_info *info);

/**
 * @brief Get current device state (thread-safe)
 */
enum clip_state clip_event_get_state(void);

/**
 * @brief Initialize the event dispatcher
 */
int clip_event_init(void);

/**
 * @brief Notify SD activity (re-arms the idle SD power-off timer)
 */
void clip_storage_activity_notify(void);

/**
 * @brief Check if the FS log backend is currently active (AT+LOG on)
 *
 * When active, idle SD power-off is suppressed (logs write to SD).
 */
bool clip_log_fs_active(void);

/**
 * @brief Wait for events (called by main loop)
 *
 * Blocks until an event is posted or timeout expires.
 *
 * @param timeout Timeout in milliseconds
 */
void clip_event_wait(k_timeout_t timeout);

/**
 * @brief Process all pending events (called by main loop)
 *
 * Must be called after clip_event_wait() returns.
 * Executes all queued events in order.
 */
void clip_event_process(void);

/**
 * @brief Cancel ongoing OTA (e.g., on BLE disconnect)
 */
void clip_event_ota_cancel(void);

#endif /* CLIP_EVENT_H */
```

## include/https_poc.h
```c
#ifndef CLIP_HTTPS_POC_H
#define CLIP_HTTPS_POC_H
#include <stdbool.h>
#include <zephyr/kernel.h>
#include "clip_event.h"
int https_poc_register(void);
bool https_poc_active(void);
bool https_poc_command_allowed(const char *name);
bool https_poc_event(enum clip_event event, struct clip_event_result_info *result,
                     bool device_idle);
int wifi_station_connect(const char *ssid, const char *password, atomic_t *cancel);
#endif
```

## src/tls_allocator.c
```c
/* App-image replacement for NCS's fixed-buffer TLS heap initializer. */
#include <zephyr/kernel.h>
#include <zephyr/init.h>
#include <mbedtls/platform.h>

static int clip_tls_heap_init(void)
{
    return mbedtls_platform_set_calloc_free(k_calloc, k_free);
}

/* Same ordering as the replaced SDK initializer, before crypto/network users. */
SYS_INIT(clip_tls_heap_init, POST_KERNEL, CONFIG_KERNEL_INIT_PRIORITY_DEVICE);
```
